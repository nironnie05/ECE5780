# file: RonnieLab1.ioc
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Mcu.Family=STM32F0
Mcu.Name=STM32F072R(8-B)Tx
Mcu.Package=LQFP64
ProjectManager.HeapSize=0x200
ProjectManager.StackSize=0x400
ProjectManager.TargetToolchain=MDK-ARM V5.32
board=custom

// file: Core/Src/main.c
/* USER CODE BEGIN Header */
/**
  ******************************************************************************
  * @file           : main.c
  * @brief          : Main program body
  ******************************************************************************
  * @attention
  *
  * Copyright (c) 2024 STMicroelectronics.
  * All rights reserved.
  *
  * This software is licensed under terms that can be found in the LICENSE file
  * in the root directory of this software component.
  * If no LICENSE file comes with this software, it is provided AS-IS.
  *
  ******************************************************************************
  */
/* USER CODE END Header */
#include "main.h"

void SystemClock_Config(void);

int main(void)
{

  /* MCU Configuration--------------------------------------------------------*/
  /* Reset of all peripherals, Initializes the Flash interface and the Systick. */
  //HAL_Init();

  /* Configure the system clock */
  SystemClock_Config();

  /* USER CODE BEGIN SysInit */
	//__HAL_RCC_GPIOC_CLK_ENABLE(); // Enable the GPIOC clock in the RCC
	//PART 1-------------------
	RCC->AHBENR |= RCC_AHBENR_GPIOCEN;
	//PART 2-------------------
	RCC->AHBENR |= RCC_AHBENR_GPIOAEN;
  /* USER CODE END SysInit */

  /* Initialize all configured peripherals */
  /* USER CODE
	__HAL_RCC_GPIOC_CLK_ENABLE(); // Enable the GPIOC clock in the RCCBEGIN 2 */
	//PART 1-CONFIG---------------------------------------------------------------------------------

	//SETUP of GPIOC 6/7 identical between PART 1 and PART 2
	GPIOC -> MODER |= GPIO_MODER_MODER6_0;
	GPIOC -> MODER |= GPIO_MODER_MODER7_0;

	GPIOC -> ODR |= GPIO_ODR_6;

	//PART 2-CONFIG--------------------------------------------------------------------------------

	//GPIOA_PA0 already configured by default for input w/out pull up pull down
	//NO CONFIG REQUIRED FOR GPIO A PIN 0.
	//Already Configured by default (00 in MODER, OTYPER, OSPEEDR, PUPDR)

  /* USER CODE END 2 */

  /* Infinite loop */
  /* USER CODE BEGIN WHILE */

	//PART 1-LOOP--------------------------------------------------------

	//while (1)
  //{
  //  /* USER CODE END WHILE */
	//	HAL_Delay(200); // Delay 200ms
	//	// Toggle the output state of both PC8 and PC9
	//	//HAL_GPIO_TogglePin(GPIOC, GPIO_PIN_8 | GPIO_PIN_9);

	//	GPIOC -> ODR ^= GPIO_ODR_6;
	//	GPIOC -> ODR ^= GPIO_ODR_7;
  //}

	//PART 2-LOOP---------------------------------------------------------
	uint32_t debouncer = 0;
  while (1)
  {
		debouncer = (debouncer << 1); // Always shift every loop iteration
		if (GPIOA->IDR & (GPIO_PIN_0)) { // If input signal is set/high
		debouncer |= 0x01; // Set lowest bit of bit-vector
		}
		if (debouncer == 0xFFFFFFFF) {
		// This code triggers repeatedly when button is steady high!
		}
		if (debouncer == 0x00000000) {
		// This code triggers repeatedly when button is steady low!
		}
		if (debouncer == 0x7FFFFFFF) {
		// This code triggers only once when transitioning
			GPIOC -> ODR ^= GPIO_ODR_6;
			GPIOC -> ODR ^= GPIO_ODR_7;
		}
	}
    /* USER CODE END WHILE */

}

void SystemClock_Config(void)
{
  RCC_OscInitTypeDef RCC_OscInitStruct = {0};
  RCC_ClkInitTypeDef RCC_ClkInitStruct = {0};

  /** Initializes the RCC Oscillators according to the specified parameters
  * in the RCC_OscInitTypeDef structure.
  */
  RCC_OscInitStruct.OscillatorType = RCC_OSCILLATORTYPE_HSI;
  RCC_OscInitStruct.HSIState = RCC_HSI_ON;
  RCC_OscInitStruct.HSICalibrationValue = RCC_HSICALIBRATION_DEFAULT;
  RCC_OscInitStruct.PLL.PLLState = RCC_PLL_NONE;
  if (HAL_RCC_OscConfig(&RCC_OscInitStruct) != HAL_OK)
  {
    Error_Handler();
  }

  /** Initializes the CPU, AHB and APB buses clocks
  */
  RCC_ClkInitStruct.ClockType = RCC_CLOCKTYPE_HCLK|RCC_CLOCKTYPE_SYSCLK
                              |RCC_CLOCKTYPE_PCLK1;
  RCC_ClkInitStruct.SYSCLKSource = RCC_SYSCLKSOURCE_HSI;
  RCC_ClkInitStruct.AHBCLKDivider = RCC_SYSCLK_DIV1;
  RCC_ClkInitStruct.APB1CLKDivider = RCC_HCLK_DIV1;

  if (HAL_RCC_ClockConfig(&RCC_ClkInitStruct, FLASH_LATENCY_0) != HAL_OK)
  {
    Error_Handler();
  }
}

void Error_Handler(void)
{
  __disable_irq();
  while (1)
  {
  }
}
